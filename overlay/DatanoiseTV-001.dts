/*
 * Copyright (C) 2012 Texas Instruments Incorporated - http://www.ti.com/
 *
 * This program is free software; you can redistribute it and/or modify
 * it under the terms of the GNU General Public License version 2 as
 * published by the Free Software Foundation.
 */
/dts-v1/;
/plugin/;

/ {
	compatible = "ti,beaglebone", "ti,beaglebone-black", "ti,beaglebone-green";

	// identification
	part-number = "datanoisetv_001";
	version = "00A0";
	
	exclusive-use =  
      "P9.27", "pru0";  
      
  fragment@0 {  
    target = <&am33xx_pinmux>;  
    __overlay__ {  
      example_pins: pinmux_pru_pru_pins {  
       pinctrl-single,pins = <  
         0x1a4 0xd
       >;  
      };  
    };  
   };  

	fragment@1 {
		target = <&pruss>;
		__overlay__ {
      pinctrl-names = "default";
      pinctrl-0 = <&example_pins>; 
			status = "okay";
		};
	};
};
